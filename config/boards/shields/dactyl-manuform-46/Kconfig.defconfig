## config/boards/shields/dactyl-manuform-46/Kconfig.defconfig
```kconfig
if SHIELD_DACTYLMANUFORM46_LEFT

config ZMK_KEYBOARD_NAME
    default "Dactyl46"

config ZMK_SPLIT_ROLE_CENTRAL
    default y  
endif

if SHIELD_DACTYLMANUFORM46_LEFT || SHIELD_DACTYLMANUFORM46_RIGHT

config ZMK_SPLIT
    default y


endif
```

## config/boards/shields/dactyl-manuform-46/Kconfig.shield
```kconfig
config SHIELD_DACTYLMANUFORM46_LEFT 
    def_bool $(shields_list_contains, DactylManuform46_left)

config SHIELD_DACTYLMANUFORM46_RIGHT 
    def_bool $(shields_list_contains, DactylManuform46_right)
```

## config/boards/shields/dactylmanuform46/Kconfig.defconfig
```kconfig
if SHIELD_DACTYLMANUFORM46_LEFT

config ZMK_SPLIT
    default y

config ZMK_SPLIT_ROLE_CENTRAL
    default y

config ZMK_KEYBOARD_NAME
    default "Dactyl46"

endif


if SHIELD_DACTYLMANUFORM46_RIGHT

config ZMK_SPLIT
    default y

config ZMK_SPLIT_ROLE_CENTRAL
    default n

endif
```

## config/boards/shields/dactylmanuform46/Kconfig.shield
```kconfig
config SHIELD_DACTYLMANUFORM46_LEFT 
    def_bool $(shields_list_contains,dactylmanuform46_left)

config SHIELD_DACTYLMANUFORM46_RIGHT 
    def_bool $(shields_list_contains,dactylmanuform46_right)
```
